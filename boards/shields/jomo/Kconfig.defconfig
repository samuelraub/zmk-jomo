## boards/shields/jomo/Kconfig.defconfig
```kconfig
if SHIELD_JOMO_LEFT

# Name must be less than 16 characters long!
config ZMK_KEYBOARD_NAME
    default "Jomo"

config ZMK_SPLIT_ROLE_CENTRAL
    default y

endif

if SHIELD_JOMO_LEFT || SHIELD_JOMO_RIGHT

config ZMK_SPLIT
    default y

endif
```

## boards/shields/jomo/Kconfig.shield
```kconfig
config SHIELD_JOMO_LEFT
    def_bool $(shields_list_contains,jomo_left)

# No whitespace after the comma or in your part name!
config SHIELD_JOMO_RIGHT
    def_bool $(shields_list_contains,jomo_right)
```
